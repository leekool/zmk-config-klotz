## config/boards/shields/klotz/Kconfig.defconfig
```kconfig
if SHIELD_KLOTZ_RIGHT

    config ZMK_KEYBOARD_NAME
        default "KLOTZ"

    config ZMK_SPLIT_BLE_ROLE_CENTRAL
        default y

endif # RIGHT



if SHIELD_KLOTZ_RIGHT || SHIELD_KLOTZ_LEFT

    config ZMK_SPLIT
        default y

endif # RIGHT LEFT



if ZMK_BACKLIGHT

    config PWM
        default y

    config LED_PWM
        default y

endif # ZMK_BACKLIGHT
```

## config/west.yml
```yaml
manifest:
  defaults:
    revision: main
  remotes:
    - name: zmkfirmware
      url-base: https://github.com/zmkfirmware
    - name: leekool
      url-base: https://github.com/leekool
  projects:
    - name: zmk
      remote: zmkfirmware
      import: app/west.yml
    - name: zmk-rgbled-widget
      remote: leekool
      revision: main
  self:
    path: config
```
